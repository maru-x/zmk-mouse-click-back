## dts/bindings/behavior/behavior-mouse-click-back.yaml
```yaml
description: "Mouse Click Back behavior binding"
compatible: "zmk,behavior-mouse-click-back"

properties:
  timeout-ms:
    type: int # 'integer' から 'int' に変更 (より一般的)
    required: true
    description: "レイヤー復帰までのタイムアウト (ms)"
  # return-layer:
  #   type: int # 'integer' から 'int' に変更 (より一般的)
  #   required: true
  #   description: "復帰先のレイヤー番号"

include: one_param.yaml
#include: two_param.yaml
#param1 is button of the mouse to click(MB1, MB2, MB3, etc.)
#param2 is the layer to return to after clicking(0,1,2, etc.)

# include: behavior-metadata.yaml

# properties:
#   label:
#     type: string
#     required: false
#     deprecated: true
#   "#binding-cells":
#     type: int
#     required: true
#     const: 2

# binding-cells:
#   - param1
#   - param2
```

## src/behaviors/Kconfig.mcb
```kconfig
config ZMK_BEHAVIOR_MOUSE_CLICK_BACK
    bool "mouse click back"
    depends on ZMK_SPLIT_ROLE_CENTRAL
    default y
    select  ZMK_MOUSE
```
